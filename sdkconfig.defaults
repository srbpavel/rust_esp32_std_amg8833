## sdkconfig.defaults
```kconfig
# Rust often needs a bit of an extra main task stack size compared to C (the default is 3K)
# memory allocation of 1120 bytes failed ???
#CONFIG_ESP_MAIN_TASK_STACK_SIZE=7000

# tracing purpose to catch thread::spawn error for ssd1306 display
# ivmarkov demo has also 20000 for led screen demo
CONFIG_ESP_MAIN_TASK_STACK_SIZE=35000

# ivanmarkov ruwm
# memory allocation of 256 bytes failed
#CONFIG_ESP_MAIN_TASK_STACK_SIZE=50000
#since mqtt NEW was ok
#CONFIG_ESP_MAIN_TASK_STACK_SIZE=60000

# needed for new wifi version !!!
# ***ERROR*** A stack overflow in task sys_evt has been detected.
CONFIG_ESP_SYSTEM_EVENT_TASK_STACK_SIZE=4096
#CONFIG_ESP_SYSTEM_EVENT_TASK_STACK_SIZE=10240

# PAVEL -> who comment this? me or default?
# Use this to set FreeRTOS kernel tick frequency to 1000 Hz (100 Hz by default).
# This allows to use 1 ms granuality for thread sleeps (10 ms by default).
CONFIG_FREERTOS_HZ=1000

# Workaround for https://github.com/espressif/esp-idf/issues/7631
#CONFIG_MBEDTLS_CERTIFICATE_BUNDLE=n
#CONFIG_MBEDTLS_CERTIFICATE_BUNDLE_DEFAULT_FULL=n
```
